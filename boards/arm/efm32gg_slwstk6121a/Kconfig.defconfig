## boards/arm/efm32gg_slwstk6121a/Kconfig.defconfig
```kconfig
# EFM32GG SLWSTK6121A default board configuration
# Copyright (c) 2019 Interay Solutions B.V.
# Copyright (c) 2019 Oane Kingma
# Copyright (c) 2020 Thorvald Natvig
# SPDX-License-Identifier: Apache-2.0

if BOARD_EFM32GG_SLWSTK6121A

config BOARD
	string
	default "efm32gg_slwstk6121a"

config CMU_HFXO_FREQ
	default 50000000

config CMU_HFRCO_FREQ
	default 72000000

config CMU_LFXO_FREQ
	default 32768

config COUNTER_GECKO_RTCC
	default y
	depends on COUNTER

config LEUART_GECKO
	default n

config HEAP_MEM_POOL_SIZE
	default 8192

if NETWORKING

config NET_L2_WIFI_MGMT
	default y

config WIFI
	default y

config WIFI_WFX
	default y

config WIFI_OFFLOAD
	default y

endif # NETWORKING

config SYS_PM_MIN_RESIDENCY_SLEEP_1
        default 0

config SYS_PM_MIN_RESIDENCY_SLEEP_2
        default 1

config SYS_PM_MIN_RESIDENCY_SLEEP_3
        default 1

config LOG_BACKEND_SWO_FREQ_HZ
        default 875000
        depends on LOG_BACKEND_SWO

endif # BOARD_EFM32GG_SLWSTK6121A
```

## drivers/timer/Kconfig.gecko
```kconfig
# Timer driver configuration options for EFx32

# Copyright (c) 2020 Thorvald Natvig
# SPDX-License-Identifier: Apache-2.0

menuconfig GECKO_SLEEPTIMER
	bool "Gecko Sleeptimer"
	depends on SOC_FAMILY_EXX32
	select SOC_GECKO_CORE
	select TICKLESS_CAPABLE
	help
	  This module implements a kernel driver for the EFx32 sleeptimer
	  library to support timer sleep in EM2 and EM3.

if GECKO_SLEEPTIMER

choice
	prompt "Gecko Sleeptimer timer choice"
	default GECKO_SLEEPTIMER_RTCC

config GECKO_SLEEPTIMER_RTCC
	bool "RTCC"
	depends on (! COUNTER_GECKO_RTCC)
	select SOC_GECKO_RTCC
	help
	  Use RTCC timer

config GECKO_SLEEPTIMER_RTC
	bool "RTC"
	select SOC_GECKO_RTC
	help
	  Use RTC timer

endchoice

choice
	prompt "Gecko Sleeptimer clock source"
	default GECKO_SLEEPTIMER_LFXO

config GECKO_SLEEPTIMER_LFRCO
	bool "LFRCO"
	help
	  Use Low-Frequency RC Oscillator (32kHz).
	  This oscillator has variance with temperature and should not be
	  used for time-keeping.
	  This oscillator is not available in EM3, and EM3 will be disabled
	  if a timer is running.

config GECKO_SLEEPTIMER_LFXO
	bool "LFXO"
	depends on (CMU_LFXO_FREQ > 0)
	help
	  Use Low-Frequency crystal oscillator (32kHz).
	  This oscillator is not available in EM3, and EM3 will be disabled
	  if a timer is running.

config GECKO_SLEEPTIMER_ULFRCO
	bool "ULFRCO"
	help
	  Use Ultra-Low-Frequency RC Oscillator (1khz).
	  This oscillator has variance with temperature and should not be
	  used for time-keeping.
	  This oscillator is available in all energy modes.

endchoice

endif # GECKO_SLEEPTIMER
```

## drivers/wifi/wfx/Kconfig.wfx
```kconfig
# SiLabs WFX WiFi driver options

# Copyright (c) 2020 Thorvald Natvig
# SPDX-License-Identifier: Apache-2.0

menuconfig WIFI_WFX
	bool "SiLabs WFX driver support"
	select WIFI_OFFLOAD
	select NET_L2_ETHERNET
	select NET_L2_WIFI_MGMT
	select NET_SOCKETS

if WIFI_WFX

config WIFI_WFX_NAME
	string "Driver name"
	default "WFX"

config WIFI_WFX_SLEEP
	bool "Enable low-energy mode"
	default y

choice WIFI_WFX_BUS
        prompt "Bus type"
        default WIFI_WFX_BUS_SDIO

config WIFI_WFX_BUS_SDIO
        bool "SDIO"

config WIFI_WFX_BUS_SPI
        bool "SPI"
        depends on SPI

endchoice

config WIFI_WFX_SECURE_LINK
	bool "Secure Link to WFX chip"
	default y
	select MBEDTLS
	select MBEDTLS_ENABLE_HEAP
	select MBEDTLS_CIPHER_CCM_ENABLED
	select MBEDTLS_KEY_EXCHANGE_ECDH_RSA_ENABLED
	select MBEDTLS_ECP_DP_CURVE25519_ENABLED
	select MBEDTLS_MAC_SHA512_ENABLED

config WIFI_WFX_SECURE_LINK_PFS
        bool
        default y
        depends on WIFI_WFX_SECURE_LINK

endif # WIFI_WFX
```
